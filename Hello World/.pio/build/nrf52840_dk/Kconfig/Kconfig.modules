## Hello World/.pio/build/nrf52840_dk/Kconfig/Kconfig.modules
```kconfig
menu "CANopenNode (C:\Users\ashok\.platformio\packages\framework-zephyr\_pio\modules\lib\canopennode)"
osource "$(ZEPHYR_CANOPENNODE_KCONFIG)"
config ZEPHYR_CANOPENNODE_MODULE
	bool
	default y
endmenu
menu "hal_nordic (C:\Users\ashok\.platformio\packages\framework-zephyr\_pio\modules\hal\nordic)"
osource "$(ZEPHYR_HAL_NORDIC_KCONFIG)"
config ZEPHYR_HAL_NORDIC_MODULE
	bool
	default y
endmenu
menu "loramac-node (C:\Users\ashok\.platformio\packages\framework-zephyr\_pio\modules\lib\loramac-node)"
osource "$(ZEPHYR_LORAMAC_NODE_KCONFIG)"
config ZEPHYR_LORAMAC_NODE_MODULE
	bool
	default y
endmenu
menu "lz4 (C:\Users\ashok\.platformio\packages\framework-zephyr\_pio\modules\lib\lz4)"
osource "$(ZEPHYR_LZ4_KCONFIG)"
config ZEPHYR_LZ4_MODULE
	bool
	default y
endmenu
menu "mbedtls (C:\Users\ashok\.platformio\packages\framework-zephyr\_pio\modules\crypto\mbedtls)"
osource "$(ZEPHYR_MBEDTLS_KCONFIG)"
config ZEPHYR_MBEDTLS_MODULE
	bool
	default y
endmenu
menu "nanopb (C:\Users\ashok\.platformio\packages\framework-zephyr\_pio\modules\lib\nanopb)"
osource "$(ZEPHYR_NANOPB_KCONFIG)"
config ZEPHYR_NANOPB_MODULE
	bool
	default y
endmenu
menu "sof (C:\Users\ashok\.platformio\packages\framework-zephyr\_pio\modules\audio\sof)"
osource "C:/Users/ashok/.platformio/packages/framework-zephyr/_pio/modules/audio/sof/zephyr/Kconfig"
config ZEPHYR_SOF_MODULE
	bool
	default y
endmenu
menu "tflite-micro (C:\Users\ashok\.platformio\packages\framework-zephyr\_pio\modules\lib\tflite-micro)"
osource "$(ZEPHYR_TFLITE_MICRO_KCONFIG)"
config ZEPHYR_TFLITE_MICRO_MODULE
	bool
	default y
endmenu
menu "TraceRecorder (C:\Users\ashok\.platformio\packages\framework-zephyr\_pio\modules\debug\TraceRecorder)"
osource "C:/Users/ashok/.platformio/packages/framework-zephyr/_pio/modules/debug/TraceRecorder/kernelports/Zephyr/Kconfig"
config ZEPHYR_TRACERECORDER_MODULE
	bool
	default y
endmenu
```
