/ {
    aliases {
        lora0 = &lora;
    };
};

&spi1 {
	sck-pin = <14>;
	miso-pin = <15>;
	mosi-pin = <13>;
	cs-gpios = <&gpio1 0x08 GPIO_ACTIVE_LOW>;

	lora: sx1280@0 {
		compatible = "semtech,sx1280";
		reg = <0>;
		label = "sx1280";
		reset-gpios = <&gpio0 26 GPIO_ACTIVE_LOW>;
		dio-gpios = <&gpio0 27 GPIO_ACTIVE_HIGH>;
		busy-gpios = <&gpio0 0x06 GPIO_ACTIVE_HIGH>;
		spi-max-frequency = <1000000>;
		power-amplifier-output = "pa-boost";
	};
};
