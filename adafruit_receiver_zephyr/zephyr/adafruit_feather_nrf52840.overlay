/ {
    aliases {
        lora0 = &lora;
    };
};

&spi1 {
	sck-pin = <14>;
	miso-pin = <15>;
	mosi-pin = <13>;
	cs-gpios = <&feather_header 14 GPIO_ACTIVE_LOW>;

	lora: sx1280@0 {
		compatible = "semtech,sx1280";
		reg = <0>;
		label = "sx1280";
		reset-gpios = <&feather_header 16 GPIO_ACTIVE_LOW>;
		dio-gpios = <&feather_header 17 GPIO_ACTIVE_HIGH>;
		spi-max-frequency = <1000000>;
		power-amplifier-output = "pa-boost";
	};
};
